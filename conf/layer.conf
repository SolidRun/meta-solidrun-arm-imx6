## conf/layer.conf
```bitbake
# We have a conf and classes directory, add to BBPATH
BBPATH .= ":${LAYERDIR}"

# We have recipes-* directories, add to BBFILES
BBFILES += "${LAYERDIR}/recipes-*/*/*.bb \
            ${LAYERDIR}/recipes-*/*/*.bbappend"

BBFILE_COLLECTIONS += "solidrun-imx6"
BBFILE_PATTERN_solidrun-imx6 = "^${LAYERDIR}/"
BBFILE_PRIORITY_solidrun-imx6 = "6"
LAYERVERSION_solidrun-imx6 = "1"
LAYERSERIES_COMPAT_solidrun-imx6 = "kirkstone"
```

## conf/machine/imx6qdlcubox.conf
```bitbake
#@TYPE: Machine
#@NAME: SolidRun i.MX6 Cubox-i & HummingBoard
#@SOC: i.MX6QDL
#@DESCRIPTION: Machine configuration for SolidRun i.MX6 Cubox-i & HummingBoard
#@MAINTAINER: Josua Mayer <josua@solid-run.com>

# This machine is compatible with i.MX6 Solo, DualLite and Quad CPUs
MACHINEOVERRIDES =. "mx6q:mx6dl"

require conf/machine/include/imx-base.inc
require conf/machine/include/arm/armv7a/tune-cortexa9.inc

MACHINE_FEATURES += "alsa bluetooth keyboard pci rtc screen serial usbgadget usbhost wifi"

# list device-tree compatible with this machine
KERNEL_DEVICETREE = " \
    imx6dl-cubox-i.dtb \
    imx6dl-cubox-i-emmc-som-v15.dtb \
    imx6dl-cubox-i-som-v15.dtb \
    imx6dl-hummingboard2.dtb \
    imx6dl-hummingboard2-cbi-emmc-som-v15.dtb \
    imx6dl-hummingboard2-cbi-som-v15.dtb \
    imx6dl-hummingboard2-emmc-som-v15.dtb \
    imx6dl-hummingboard2-som-v15.dtb \
    imx6dl-hummingboard.dtb \
    imx6dl-hummingboard-emmc-som-v15.dtb \
    imx6dl-hummingboard-som-v15.dtb \
    imx6dl-solidsense.dtb \
    imx6q-hummingboard2.dtb \
    imx6q-hummingboard2-cbi-emmc-som-v15.dtb \
    imx6q-hummingboard2-cbi-som-v15.dtb \
    imx6q-hummingboard2-emmc-som-v15.dtb \
    imx6q-hummingboard2-som-v15.dtb \
    imx6q-hummingboard.dtb \
    imx6q-hummingboard-emmc-som-v15.dtb \
    imx6q-hummingboard-som-v15.dtb \
    imx6q-cubox-i.dtb \
    imx6q-cubox-i-emmc-som-v15.dtb \
    imx6q-cubox-i-som-v15.dtb \
    imx6q-solidsense.dtb \
"

# include drivers & firmware
# find tmp/work/imx6qdlcubox-poky-linux-gnueabi/linux-fslc/6.0.8+git999-r0/packages-split -type f -name imx_sdma.ko
MACHINE_EXTRA_RDEPENDS:append:mx6 = " \
    kernel-module-bnep \
    kernel-module-coda-vpu \
    kernel-module-dw-hdmi-ahb-audio \
    kernel-module-evbug \
    kernel-module-gpio-ir-recv \
    kernel-module-imx-sdma \
    kernel-module-imx-vdoa \
    kernel-module-ir-imon-decoder \
    kernel-module-ir-jvc-decoder \
    kernel-module-ir-nec-decoder \
    kernel-module-ir-rc6-decoder \
    kernel-module-ir-rcmm-decoder \
    kernel-module-ir-sanyo-decoder \
    kernel-module-ir-sharp-decoder \
    kernel-module-ir-sony-decoder \
    kernel-module-ir-xmp-decoder \
    kernel-module-v4l2-jpeg \
    kernel-module-wl18xx \
    kernel-module-wlcore \
    kernel-module-wlcore-sdio \
    linux-firmware-bcm4329 \
    linux-firmware-bcm4330 \
    linux-firmware-wl18xx \
"

# default to Vendor U-Boot for
PREFERRED_PROVIDER_virtual/bootloader = "u-boot-solidrun-imx6"
PREFERRED_PROVIDER_u-boot = "u-boot-solidrun-imx6"

# for u-boot-* package (default)
UBOOT_MACHINE = "mx6cuboxi_defconfig"
SPL_BINARY = "SPL"
UBOOT_SUFFIX = "img"

# I don't understand this, but it relates to how U-Boot is installed ...
WKS_FILE = " \
    ${@bb.utils.contains('IMX_DEFAULT_BOOTLOADER', \
                         'u-boot-fslc', 'imx-uboot-spl-bootpart.wks.in', \
                                        'imx-uboot-bootpart.wks.in', d)}"

# Use a boot.scr to allow for generating appropriate root= bootargs on the fly
UBOOT_ENV = "boot"
UBOOT_ENV_SRC_SUFFIX = "txt"
UBOOT_ENV_SUFFIX = "scr"
IMAGE_BOOT_FILES:append = "boot.scr"
```

## conf/machine/solidrun-imx6.conf
```bitbake
#@TYPE: Machine
#@NAME: SolidRun CuBox-i and HummingBoard
#@SOC: i.MX6 Q/DL
#@DESCRIPTION: Machine configuration for SolidRun CuBox-i and HummingBoard machines
#@MAINTAINER: Carlos Rafael Giani <dv@pseudoterminal.org>

# Machine config for the SolidRun CuBox-i and HummingBoard machines.
# They all use the same machine config, since the u-boot SPL autodetects the
# machine type upon booting. SOC_FAMILY includes all SoCs from all of these machines
# to let recipes include firmware etc. for all of these SoCs.

MACHINEOVERRIDES =. "mx6:mx6dl:mx6q:"

require conf/machine/include/imx-base.inc
require conf/machine/include/tune-cortexa9.inc

PREFERRED_PROVIDER_virtual/bootloader = "u-boot-solidrun-imx6"
PREFERRED_PROVIDER_virtual/kernel = "linux-solidrun-imx6"

UBOOT_MACHINE ?= "mx6cuboxi_defconfig"
UBOOT_MAKE_TARGET = "all"
UBOOT_SUFFIX = "img"
SPL_BINARY = "SPL"
WKS_FILE = "imx-uboot-spl.wks"
IMAGE_BOOT_FILES_append = " extlinux.conf;extlinux/extlinux.conf"

UBOOT_EXTLINUX = "1"
UBOOT_EXTLINUX_ROOT = "root=PARTUUID=${uuid}"

KERNEL_IMAGETYPE = "zImage"
KERNEL_DEVICETREE = " \
    imx6dl-cubox-i.dtb \
    imx6dl-cubox-i-emmc-som-v15.dtb \
    imx6dl-cubox-i-som-v15.dtb \
    imx6dl-hummingboard2.dtb \
    imx6dl-hummingboard2-emmc.dtb \
    imx6dl-hummingboard2-emmc-som-v15.dtb \
    imx6dl-hummingboard2-som-v15.dtb \
    imx6dl-hummingboard.dtb \
    imx6dl-hummingboard-emmc-som-v15.dtb \
    imx6dl-hummingboard-som-v15.dtb \
    imx6q-cubox-i.dtb \
    imx6q-cubox-i-emmc-som-v15.dtb \
    imx6q-cubox-i-som-v15.dtb \
    imx6q-hummingboard2.dtb \
    imx6q-hummingboard2-emmc.dtb \
    imx6q-hummingboard2-emmc-som-v15.dtb \
    imx6q-hummingboard2-som-v15.dtb \
    imx6q-hummingboard.dtb \
    imx6q-hummingboard-emmc-som-v15.dtb \
    imx6q-hummingboard-som-v15.dtb \
"
MACHINE_FEATURES += "pci wifi bluetooth alsa irda serial usbhost"
MACHINE_EXTRA_RRECOMMENDS += "firmware-wireless-brcm firmware-wireless-wilink8 "

MACHINE_HAS_VIVANTE_KERNEL_DRIVER_SUPPORT = "1" 
MACHINE_USES_VIVANTE_KERNEL_DRIVER_MODULE = "0"

SERIAL_CONSOLE = "115200 ttymxc0"

MACHINE_ESSENTIAL_EXTRA_RDEPENDS += " \
    kernel-image \
    kernel-devicetree \
    u-boot-solidrun-imx6 \
"
```
